## package/glibc/Config.in
```kconfig
if BR2_TOOLCHAIN_BUILDROOT_GLIBC

comment "Glibc Options"

config BR2_PACKAGE_GLIBC
	bool
	default y
	select BR2_PACKAGE_LINUX_HEADERS if !BR2_GNU_HURD
	select BR2_PACKAGE_HURD_HEADERS if BR2_GNU_HURD
	select BR2_TOOLCHAIN_HAS_SSP if BR2_PACKAGE_HOST_BINUTILS_SUPPORTS_CFI
	help
	  https://www.gnu.org/software/libc/

config BR2_PACKAGE_GLIBC_UTILS
	bool "Install glibc utilities"
	help
	  Enabling this option will compile and install the getconf,
	  ldconfig, ldd and locale glibc utilities for the target.

endif # BR2_TOOLCHAIN_BUILDROOT_GLIBC
```

## package/hurd/Config.in
```kconfig
config BR2_PACKAGE_HURD
	depends on BR2_PACKAGE_LIBGPG_ERROR_ARCH_SUPPORTS
	select BR2_PACKAGE_BZIP2
	select BR2_PACKAGE_LIBDAEMON
	select BR2_PACKAGE_LIBGCRYPT
	select BR2_PACKAGE_LIBPCIACCESS
	select BR2_PACKAGE_ZLIB
	bool
```

## package/libcanberra/Config.in
```kconfig
config BR2_PACKAGE_LIBCANBERRA
	bool "libcanberra"
	select BR2_PACKAGE_LIBVORBIS
	help
	  libcanberra defines a simple abstract interface for playing event sounds.

	  http://0pointer.de/lennart/projects/libcanberra/
```

## package/libeet/Config.in
```kconfig
config BR2_PACKAGE_LIBEET
	bool "libeet"
	select BR2_PACKAGE_ZLIB
	select BR2_PACKAGE_JPEG
	select BR2_PACKAGE_LIBEINA
	depends on BR2_USE_MMU
	depends on BR2_USE_WCHAR # efl
	help
	  Eet is a tiny library designed to write an arbitary set of
	  chunks of data to a file and optionally compress each chunk
	  (very much like a zip file).

	  http://trac.enlightenment.org/e/wiki/Eet

comment "libeet needs a toolchain w/ wchar"
	depends on !BR2_USE_WCHAR
```

## package/libefreet/Config.in
```kconfig
config BR2_PACKAGE_LIBEFREET
	bool "libefreet"
	select BR2_PACKAGE_LIBEINA
	select BR2_PACKAGE_LIBEET
	select BR2_PACKAGE_LIBECORE
	depends on BR2_USE_MMU # efl
	depends on BR2_USE_WCHAR # efl
	help
	  Efreet is a library designed to help apps work with several of the
	  Freedesktop.org standards regarding Icons, Desktop files and Menus.

	  http://trac.enlightenment.org/e/wiki/Efreet

comment "libefreet needs a toolchain w/ wchar"
	depends on !BR2_USE_WCHAR
```
