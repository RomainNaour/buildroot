## configs/hurd_defconfig
```kconfig
BR2_x86_i686=y
BR2_GNU_HURD=y
BR2_TOOLCHAIN_BUILDROOT_GLIBC=y
BR2_BINUTILS_VERSION_2_35_X=y
BR2_GCC_VERSION_10_X=y
BR2_TOOLCHAIN_BUILDROOT_CXX=y
BR2_INIT_NONE=y
BR2_SYSTEM_BIN_SH_BASH=y
BR2_SYSTEM_ENABLE_NLS=y
BR2_TARGET_TZ_INFO=y
BR2_PACKAGE_PARTED=y
BR2_PACKAGE_NANO=y
# BR2_PACKAGE_BUSYBOX is not set
BR2_PACKAGE_COREUTILS=y
BR2_PACKAGE_COREUTILS_INDIVIDUAL_BINARIES=y
BR2_PACKAGE_PROCPS_NG=y
BR2_PACKAGE_DMIDECODE=y
BR2_PACKAGE_FINDUTILS=y
BR2_PACKAGE_GREP=y
BR2_PACKAGE_LESS=y
BR2_PACKAGE_LOGROTATE=y
BR2_PACKAGE_UTIL_LINUX_NOLOGIN=y
BR2_PACKAGE_SED=y
BR2_PACKAGE_LINUX_PAM=y

BR2_SHARED_STATIC_LIBS=y

BR2_ROOTFS_DEVICE_TABLE="board/qemu/hurd/system/device_table.txt"
BR2_ROOTFS_POST_FAKEROOT_SCRIPT="board/qemu/hurd/fakerooted-hurd-script.sh"

# Bootloader
BR2_TARGET_GRUB2=y
# Hurd needs some additional builtins
BR2_TARGET_GRUB2_BUILTIN_MODULES="boot extcmd loadenv  echo multiboot multiboot2 linux ext2 fat squash4 part_msdos part_gpt normal biosdisk probe"

# Filesystem / image
# only ext2 supported by hurd, we need to use 4096 blocksize to boot.
BR2_TARGET_ROOTFS_EXT2=y
BR2_TARGET_ROOTFS_EXT2_SIZE="1G"
BR2_TARGET_ROOTFS_EXT2_MKFS_OPTIONS="-v -O ^64bit  -b 4096 -o hurd  -O ext_attr"
# BR2_TARGET_ROOTFS_TAR is not set
BR2_ROOTFS_POST_BUILD_SCRIPT="board/qemu/hurd/post-build.sh"
BR2_ROOTFS_POST_IMAGE_SCRIPT="support/scripts/genimage.sh"
BR2_ROOTFS_POST_SCRIPT_ARGS="-c board/qemu/hurd/genimage-bios.cfg"
BR2_ROOTFS_OVERLAY="board/qemu/hurd/rootfsoverlay"


BR2_PACKAGE_HOST_DOSFSTOOLS=y

# Required tools to create bootable media
BR2_PACKAGE_HOST_GENIMAGE=y
```

## configs/qemu_nios2_10m50_defconfig
```kconfig
BR2_nios2=y
BR2_TOOLCHAIN_EXTERNAL=y
BR2_LINUX_KERNEL=y
BR2_LINUX_KERNEL_DEFCONFIG="10m50"
BR2_LINUX_KERNEL_CONFIG_FRAGMENT_FILES="board/qemu/nios2-10m50/linux-4.8.fragment"
BR2_TARGET_ROOTFS_INITRAMFS=y
```

## package/bullet/Config.in
```kconfig
config BR2_PACKAGE_BULLET
	bool "bullet"
	depends on BR2_INSTALL_LIBSTDCPP # Check for g++
	help
	  Bullet is a Collision Detection and Rigid Body Dynamics Library.
```

## package/clang/Config.in.host
```kconfig
config BR2_PACKAGE_HOST_CLANG
	bool "host clang"
	depends on BR2_HOST_GCC_AT_LEAST_4_7 # llvm
	depends on BR2_aarch64 || BR2_arm || BR2_i386 || BR2_x86_64 # llvm
	select BR2_PACKAGE_HOST_LLVM
	help
	  Clang is a C++, Objective C and Objective C++ front-end for
	  the LLVM compiler.

	  http://llvm.org
```

## package/e-cho/Config.in
```kconfig
config BR2_PACKAGE_E_CHO
	bool "echo (game)"
	depends on BR2_PACKAGE_EFL
	select BR2_PACKAGE_ELEMENTARY
	select BR2_PACKAGE_LIBCANBERRA
	select BR2_PACKAGE_LIBETROPHY
	help
	  Echo is a game based on the classic game Simon Says,  written
	  using Enlightenment Foundation Libraries (EFL).
```

## package/econnman/Config.in
```kconfig
config BR2_PACKAGE_ECONNMAN
	bool "econnman"
	depends on BR2_PACKAGE_EFL
	select BR2_PACKAGE_ELEMENTARY
	select BR2_PACKAGE_DBUS_PYTHON
	depends on BR2_PACKAGE_PYTHON || BR2_PACKAGE_PYTHON3 # dbus-python
	help
	  ConnMan User Interface in EFL
```

## package/ecrire/Config.in
```kconfig
config BR2_PACKAGE_ECRIRE
	bool "ecrire"
	depends on BR2_PACKAGE_EFL
	select BR2_PACKAGE_ELEMENTARY
	help
	  Ecrire is a simple text editor based on EPL libraries.
```

## package/efl/Config.in
```kconfig
menu "Enlightenment Foundation Libraries"

source "package/efl/efl/Config.in"
source "package/efl/libelementary/Config.in"

endmenu
```

## package/efl/efl-core/Config.in
```kconfig
config BR2_PACKAGE_EFLCORE
	bool "efl-core"
	depends on BR2_TOOLCHAIN_HAS_THREADS
	depends on BR2_USE_WCHAR
	depends on BR2_PACKAGE_HAS_UDEV # libudev
	depends on BR2_INSTALL_LIBSTDCPP
	select BR2_PACKAGE_DBUS
	select BR2_PACKAGE_FREETYPE
	select BR2_PACKAGE_LIBCURL # eina_module, runtime dependency
	select BR2_PACKAGE_LUA # Evas lua 5.1 or 5.2
	select BR2_PACKAGE_GETTEXT if BR2_NEEDS_GETTEXT_IF_LOCALE
	select BR2_PACKAGE_LIBXKBCOMMON if BR2_PACKAGE_WAYLAND
	help

if BR2_PACKAGE_EFLCORE

config BR2_PACKAGE_EFLCORE_RECOMMENDED_CONFIG
	bool "Use recommanded and tested configurations"
	select BR2_PACKAGE_BULLET
	select BR2_PACKAGE_FONTCONFIG
	select BR2_PACKAGE_GSTREAMER1
	select BR2_PACKAGE_GST1_PLUGINS_BASE
	select BR2_PACKAGE_LIBFRIBIDI
	select BR2_PACKAGE_LIBSNDFILE
	select BR2_PACKAGE_PULSEAUDIO
	select BR2_PACKAGE_UTIL_LINUX
	select BR2_PACKAGE_UTIL_LINUX_LIBMOUNT
	select BR2_PACKAGE_UTIL_LINUX_LIBBLKID
	default y
	help
	  Avoid to use untested or not recommanded configurations, otherwise we
	  need to add a very long and obscure option to start the build.

comment "libecore video support"

config BR2_PACKAGE_EFLCORE_FB
	bool "libecore framebuffer support"

config BR2_PACKAGE_EFLCORE_X
	bool "libecore X support"
	depends on BR2_PACKAGE_XORG7
	select BR2_PACKAGE_XLIB_LIBX11
	select BR2_PACKAGE_XLIB_LIBXEXT

config BR2_PACKAGE_EFLCORE_SDL2
	bool "libevas SDL2 support"
	depends on !BR2_PACKAGE_EFLCORE_X_XLIB_GLX_ES
	select BR2_PACKAGE_SDL2

comment "libecore SDL support"

if BR2_PACKAGE_EFLCORE_X

choice
	prompt "select libecore XLIB/XCB support"

config BR2_PACKAGE_EFLCORE_X_XLIB
	bool "libecore XLIB support"
	select BR2_PACKAGE_XLIB_LIBXCOMPOSITE
	select BR2_PACKAGE_XLIB_LIBXCURSOR
	select BR2_PACKAGE_XLIB_LIBXDAMAGE
	select BR2_PACKAGE_XLIB_LIBXINERAMA
	select BR2_PACKAGE_XLIB_LIBXP
	select BR2_PACKAGE_XLIB_LIBXRANDR
	select BR2_PACKAGE_XLIB_LIBXRENDER
	select BR2_PACKAGE_XLIB_LIBXSCRNSAVER
	select BR2_PACKAGE_XLIB_LIBXTST
	select BR2_PACKAGE_XPROTO_GLPROTO

config BR2_PACKAGE_EFLCORE_X_XCB
	bool "libecore XCB support"
	depends on !BR2_PACKAGE_EFLCORE_RECOMMENDED_CONFIG
	select BR2_PACKAGE_LIBXCB
	select BR2_PACKAGE_XCB_UTIL_IMAGE # xcb-image.pc
	select BR2_PACKAGE_XCB_UTIL_KEYSYMS # xcb-keysyms.pc
	select BR2_PACKAGE_XCB_UTIL_RENDERUTIL # xcb-renderutil.pc
	select BR2_PACKAGE_XCB_UTIL_WM # xcb-icccm.pc
	select BR2_PACKAGE_XLIB_LIBX11

comment "for libecore XCB support disable recommanded configurations"
	depends on BR2_PACKAGE_EFLCORE_RECOMMENDED_CONFIG

endchoice

if BR2_PACKAGE_EFLCORE_X_XLIB

choice
	prompt "select libevas OpenGL support"

config BR2_PACKAGE_EFLCORE_X_XLIB_GLX_FULL
	bool "libevas OpenGL full support"
	depends on BR2_PACKAGE_HAS_LIBGL

comment "libevas OpenGLES support needs libgl"
	depends on !BR2_PACKAGE_HAS_LIBGL

config BR2_PACKAGE_EFLCORE_X_XLIB_GLX_ES
	bool "libevas OpenGLES support"
	depends on BR2_PACKAGE_HAS_LIBGLES

comment "libevas OpenGLES support needs libgles"
	depends on !BR2_PACKAGE_HAS_LIBGLES

config BR2_PACKAGE_EFLCORE_X_XLIB_GLX_NONE
	bool "libevas disable OpenGL support"

endchoice

endif # BR2_PACKAGE_EFLCORE_X_XLIB

endif # BR2_PACKAGE_EFLCORE_X

comment "libevas loaders"

config BR2_PACKAGE_EFLCORE_PNG
	bool "libevas png loader"
	select BR2_PACKAGE_LIBPNG
	help
	  This enables the loader code that loads png files using
	  libpng.

config BR2_PACKAGE_EFLCORE_JPEG
	bool "libevas jpeg loader"
	select BR2_PACKAGE_JPEG
	help
	  This enables the loader code that loads jpeg files using
	  libjpeg.

config BR2_PACKAGE_EFLCORE_GIF
	bool "libevas gif loader"
	select BR2_PACKAGE_GIFLIB
	help
	  This enables the loader code that loads gif files using
	  libungif.

config BR2_PACKAGE_EFLCORE_TIFF
	bool "libevas tiff loader"
	select BR2_PACKAGE_TIFF
	help
	  This enables the loader code that loads tiff files.

config BR2_PACKAGE_EFLCORE_JP2K
	bool "libevas jp2k loader"
	select BR2_PACKAGE_OPENJPEG
	help
	  This enables the loader code that loads jp2k files.

config BR2_PACKAGE_EFLCORE_WEBP
	bool "libevas webp image loader"
	help
	  This enables the loader code that loads images using WebP.

endif # BR2_PACKAGE_EFLCORE

comment "efl-core needs a toolchain w/ threads, wchar, C++"
	depends on !BR2_TOOLCHAIN_HAS_THREADS || !BR2_USE_WCHAR || !BR2_INSTALL_LIBSTDCPP
```

## package/efl/libefl/Config.in
```kconfig
config BR2_PACKAGE_LIBEFL
	bool "libefl"
	depends on BR2_INSTALL_LIBSTDCPP
	depends on BR2_PACKAGE_HAS_UDEV # libudev
	depends on BR2_PACKAGE_LUA # lua 5.1 or better
	depends on BR2_TOOLCHAIN_HAS_THREADS # untested without threads
	depends on BR2_USE_MMU
	depends on BR2_USE_WCHAR # use wchar_t
	depends on !BR2_STATIC_LIBS # dlfcn.h
	select BR2_PACKAGE_DBUS
	select BR2_PACKAGE_FREETYPE
	select BR2_PACKAGE_JPEG # Emile needs libjpeg
	select BR2_PACKAGE_LIBCURL # Ecore_con_url, runtime dependency
	select BR2_PACKAGE_UTIL_LINUX
	# libblkid is part of required tools, see EFL's README.
	select BR2_PACKAGE_UTIL_LINUX_LIBBLKID
	help
	  Enlightenment Foundation Libraries

	  https://enlightenment.org

if BR2_PACKAGE_LIBEFL

config BR2_PACKAGE_LIBEFL_RECOMMENDED_CONFIG
	bool "Use recommended and tested configurations"
	depends on BR2_ARCH_HAS_ATOMICS # pulseaudio
	select BR2_PACKAGE_BULLET
	select BR2_PACKAGE_FONTCONFIG
	select BR2_PACKAGE_GSTREAMER1
	select BR2_PACKAGE_GST1_PLUGINS_BASE
	select BR2_PACKAGE_LIBFRIBIDI
	select BR2_PACKAGE_LIBSNDFILE
	select BR2_PACKAGE_PULSEAUDIO
	select BR2_PACKAGE_UTIL_LINUX_LIBMOUNT
	default y
	help
	  Enable the basic set of recommended features.

	  Without that, the EFL developpers consider the build to be
	  potentially broken and won't provide any support for it.

	  This turns on the following features:

	  - bullet: If you have chosen to disable physics support, this
	    disables lots of core functionality and is effectively never
	    tested. You are going to find features that suddenly don't work
	    and as a result cause a series of breakages. This is simply not
	    tested so you are on your own in terms of ensuring everything
	    works if you do this

	  - fontconfig: If fontconfig is disabled, this is going to make
	    general font searching not work, and only some very direct
	    'load /path/file.ttf' will work alongside some old-school ttf
	    file path searching. This is very likely not what you want, so
	    highly reconsider turning fontconfig off. Having it off will
	    lead to visual problems like missing text in many UI areas
	    etc...

	  - gstreamer 1.x: If Gstreamer 1.x support is disabled, it will
	    heavily limit your media support options and render some
	    functionality as useless, leading to visible application bugs.

	  - libfribidi: Fribidi is used for handling right-to-left text
	    (like Arabic, Hebrew, Farsi, Persian etc.) and is very likely
	    not a feature you want to disable unless you know for absolute
	    certain you will never encounter and have to display such
	    scripts. Also note that we don't test with fribidi disabled so
	    you may also trigger code paths with bugs that are never
	    normally used.

	  - libsndfile: If you disabled audio support in Ecore, this is not
	    tested and may create bugs for you due to it creating untested
	    code paths. Reconsider disabling audio.

	  - pulseaudio: The only audio output method supported by Ecore
	    right now is via Pulseaudio. You have disabled that and likely
	    have broken a whole bunch of things in the process. Reconsider
	    your configure options.
	    NOTE: multisense support is automatically enabled with
	    pulseaudio.

	  - util-linux' libmount: Libmount is used heavily inside Eeze for
	    support of removable devices etc... and disabling this will
	    hurt support for Enlightenment and its filemanager.

comment "libevas loaders"

config BR2_PACKAGE_LIBEFL_PNG
	bool "libevas png loader"
	select BR2_PACKAGE_LIBPNG
	help
	  This enables the loader code that loads png files using
	  libpng.

config BR2_PACKAGE_LIBEFL_JPEG
	bool "libevas jpeg loader"
	help
	  This enables the loader code that loads jpeg files using
	  libjpeg.

config BR2_PACKAGE_LIBEFL_GIF
	bool "libevas gif loader"
	select BR2_PACKAGE_GIFLIB
	help
	  This enables the loader code that loads gif files using
	  libungif.

config BR2_PACKAGE_LIBEFL_TIFF
	bool "libevas tiff loader"
	select BR2_PACKAGE_TIFF
	help
	  This enables the loader code that loads tiff files.

endif # BR2_PACKAGE_LIBEFL
```

## package/efl/libelementary/Config.in
```kconfig
config BR2_PACKAGE_LIBELEMENTARY
	bool "libelementary"
	help
	  Elementary is a widget toolkit and EFL wrapper and convenience
	  library to make it easy to build applications and tools with UIs
	  with less code.

	  https://enlightenment.org
```

## package/elemines/Config.in
```kconfig
config BR2_PACKAGE_ELEMINES
	bool "elemines"
	depends on BR2_PACKAGE_EFL
	select BR2_PACKAGE_ELEMENTARY
	select BR2_PACKAGE_LIBETROPHY
	help
	  Elemines is an EFL minesweeper clone.

	  http://elemines.sourceforge.net/
```

## package/empc/Config.in
```kconfig
config BR2_PACKAGE_EMPC
	bool "empc"
	depends on BR2_PACKAGE_EFL
	select BR2_PACKAGE_ELEMENTARY
	select BR2_PACKAGE_LIBMPDCLIENT
	help
	  EMPC is a client for MPD written using EFL.
```

## package/enlightenment/Config.in
```kconfig
config BR2_PACKAGE_ENLIGHTENMENT
	bool "enlightenment"
	select BR2_PACKAGE_EFL
	select BR2_PACKAGE_LIBEFL_X
	select BR2_PACKAGE_LIBEFL_JPEG # needed at runtime by enlightenment_start
	select BR2_PACKAGE_LIBEFL_PNG # needed at runtime by enlightenment_start
	select BR2_PACKAGE_LIBELEMENTARY
	select BR2_PACKAGE_LIBEVAS_GENERIC_LOADERS
	select BR2_PACKAGE_LIBEVAS_GENERIC_LOADERS_SVG
	select BR2_PACKAGE_XCB_UTIL_KEYSYMS
	# libevas-generic-loaders-svg -> librsvg -> pango -> cairo
	depends on BR2_ARCH_HAS_ATOMICS
	depends on BR2_INSTALL_LIBSTDCPP
	depends on BR2_PACKAGE_HAS_UDEV # libefl -> libudev
	depends on BR2_PACKAGE_XORG7
	depends on BR2_TOOLCHAIN_HAS_THREADS # libefl
	depends on BR2_USE_MMU # libefl
	depends on !BR2_STATIC_LIBS # libefl
	depends on BR2_USE_WCHAR # libefl
	help
	  Enlightenment, also known simply as E, is a stacking window
	  manager for the X Window System which can be used alone or
	  in conjunction with a desktop environment such as GNOME or
	  KDE. Enlightenment can be used as a substitute for a full
	  desktop environment.

	  http://www.enlightenment.org/

comment "enlightenment needs udev /dev management and a toolchain w/ C++, dynamic library, threads, wchar"
	depends on BR2_PACKAGE_XORG7 && BR2_USE_MMU
	depends on !BR2_PACKAGE_HAS_UDEV || !BR2_INSTALL_LIBSTDCPP || BR2_STATIC_LIBS || !BR2_TOOLCHAIN_HAS_THREADS || !BR2_USE_WCHAR
	depends on BR2_ARCH_HAS_ATOMICS
```

## package/ephysics-tests/Config.in
```kconfig
config BR2_PACKAGE_EPHYSICS_TEST
	bool "ephysics tests"
	depends on BR2_PACKAGE_EFL
	select BR2_PACKAGE_BULLET
	select BR2_PACKAGE_ELEMENTARY
	depends on BR2_INSTALL_LIBSTDCPP # bullet
	help
	  EPhysics Tests provides many tests for ephysics. It consists of
	  three binaries:
	  * ephysics_test (a test suite)
	  * ephysics_sandbox (util for testing physics attributes and actions)
	  * ephysics_logo (example of fancy program logo using ephysics)

comment "ephysics tests needs toolchain w/ C++"
	depends on !BR2_INSTALL_LIBSTDCPP
```

## package/espionage/Config.in
```kconfig
config BR2_PACKAGE_ESPIONAGE
	bool "espionage"
	depends on BR2_PACKAGE_EFL
	select BR2_PACKAGE_PYTHON_EFL
	depends on BR2_PACKAGE_PYTHON || BR2_PACKAGE_PYTHON3 # python-efl
	help
	  A complete D-Bus inspector written in python that use the EFL

	  https://git.enlightenment.org/apps/espionage.git
```

## package/expedite/Config.in
```kconfig
config BR2_PACKAGE_EXPEDITE
	bool "expedite"
	select BR2_PACKAGE_EFL
	depends on BR2_INSTALL_LIBSTDCPP # libefl
	depends on BR2_PACKAGE_HAS_UDEV # libefl -> libudev
	depends on BR2_USE_MMU # libefl
	depends on BR2_TOOLCHAIN_HAS_THREADS # libefl
	depends on !BR2_STATIC_LIBS # libefl
	depends on BR2_USE_WCHAR # libefl
	help
	  Expedite is the official Evas benchmark tool. It can test different
	  engines, such as X11, XRender, OpenGL (also ES variant), SDL,
	  DirectFB and so on. Its tests are quite extensive, trying to
	  reproduce real world usage cases.

comment "expedite needs udev /dev management and a toolchain w/ C++, dynamic library, threads, wchar"
	depends on !BR2_PACKAGE_HAS_UDEV || !BR2_INSTALL_LIBSTDCPP || BR2_STATIC_LIBS || !BR2_TOOLCHAIN_HAS_THREADS || !BR2_USE_WCHAR
	depends on BR2_USE_MMU
```
