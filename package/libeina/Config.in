## package/libeina/Config.in
```kconfig
config BR2_PACKAGE_LIBEINA
	bool "libeina"
	depends on BR2_USE_MMU # efl
	depends on BR2_USE_WCHAR # efl
	
	help
	  Eina is a tiny library to handle data types (list, hash, etc.)

	  http://trac.enlightenment.org/e/wiki/Eina

comment "libeina needs a toolchain w/ wchar"
	depends on !BR2_USE_WCHAR
```

## package/libelementary/Config.in
```kconfig
config BR2_PACKAGE_LIBELEMENTARY
	bool "libelementary"
	select BR2_PACKAGE_EFL
	depends on BR2_INSTALL_LIBSTDCPP # efl
	depends on BR2_PACKAGE_HAS_UDEV # efl -> libudev
	depends on BR2_USE_MMU # efl
	depends on !BR2_STATIC_LIBS # efl
	depends on BR2_USE_WCHAR # efl
	help
	  Elementary is a widget toolkit and EFL wrapper and convenience
	  library to make it easy to build applications and tools with UIs
	  with less code.

	  https://enlightenment.org

comment "libelementary needs udev /dev management and a toolchain w/ C++, dynamic library, wchar"
	depends on !BR2_PACKAGE_HAS_UDEV || !BR2_INSTALL_LIBSTDCPP || BR2_STATIC_LIBS || !BR2_USE_WCHAR
	depends on BR2_USE_MMU
```

## package/libembryo/Config.in
```kconfig
config BR2_PACKAGE_LIBEMBRYO
	bool "libembryo"
	select BR2_PACKAGE_LIBEINA
	depends on BR2_USE_MMU # efl
	depends on BR2_USE_WCHAR # efl
	help
	  Embryo is primarily a shared library that gives you an API
	  to load and control interpreted programs compiled into an
	  abstract machine bytecode that it understands.

	  http://trac.enlightenment.org/e/wiki/Embryo

comment "libembryo needs a toolchain w/ wchar"
	depends on !BR2_USE_WCHAR
```

## package/libemotion-generic-players/Config.in
```kconfig
config BR2_PACKAGE_LIBEMOTION_GENERIC_PLAYERS
	bool "libemotion generic players"
	depends on BR2_PACKAGE_EFL
	depends on BR2_INSTALL_LIBSTDCPP # vlc
	depends on BR2_USE_MMU # vlc
	depends on BR2_USE_WCHAR # vlc
	depends on !BR2_STATIC_LIBS # vlc
	depends on BR2_TOOLCHAIN_HAS_THREADS # vlc
	depends on BR2_TOOLCHAIN_HEADERS_AT_LEAST_3_7 # vlc
	select BR2_PACKAGE_VLC # needs libvlc
	help
	  A media object library for Evas and Ecore.

	  https://www.enlightenment.org
	  https://docs.enlightenment.org/stable/efl/emotion_main.html

comment "libemotion generic players needs a toolchain w/ C++, wchar, threads, headers >= 3.7"
	depends on !BR2_INSTALL_LIBSTDCPP || !BR2_USE_WCHAR || BR2_STATIC_LIBS \
		|| !BR2_TOOLCHAIN_HAS_THREADS || !BR2_TOOLCHAIN_HEADERS_AT_LEAST_3_7
```

## package/libethumb/Config.in
```kconfig
comment "libethumb needs a toolchain w/ threads, wchar"
	depends on !BR2_TOOLCHAIN_HAS_THREADS || !BR2_USE_WCHAR

config BR2_PACKAGE_LIBETHUMB
	bool "libethumb"
	select BR2_PACKAGE_LIBEINA
	select BR2_PACKAGE_LIBEVAS
	select BR2_PACKAGE_LIBECORE
	select BR2_PACKAGE_LIBECORE_EVAS
	select BR2_PACKAGE_LIBEDJE
	depends on BR2_TOOLCHAIN_HAS_THREADS # libevas
	depends on BR2_USE_MMU # efl
	depends on BR2_USE_WCHAR # efl
	help
	  Ethumb is a library for generating thumbnail images of documents.

	  http://trac.enlightenment.org/e/wiki/Ethumb
```

## package/libetrophy/Config.in
```kconfig
config BR2_PACKAGE_LIBETROPHY
	bool "libetrophy"
	depends on BR2_PACKAGE_EFL
	select BR2_PACKAGE_ELEMENTARY
	help
	  Etrophy is a library that manages scores, trophies and
	  unlockables. It will store them and provide views to display
	  them. Could be used by games based on EFL.
```

## package/libevas-generic-loaders/Config.in
```kconfig
config BR2_PACKAGE_LIBEVAS_GENERIC_LOADERS
	bool "libevas generic loaders"
	select BR2_PACKAGE_EFL
	select BR2_PACKAGE_ZLIB
	depends on BR2_INSTALL_LIBSTDCPP # libefl
	depends on BR2_PACKAGE_HAS_UDEV # libefl -> libudev
	depends on BR2_TOOLCHAIN_HAS_THREADS # libefl
	depends on BR2_USE_MMU # libefl
	depends on !BR2_STATIC_LIBS # libefl
	depends on BR2_USE_WCHAR # libefl
	help
	  These are additional "generic" loaders for Evas that are
	  stand-alone executables that evas may run from its generic
	  loader module.

	  https://www.enlightenment.org/

if BR2_PACKAGE_LIBEVAS_GENERIC_LOADERS

config BR2_PACKAGE_LIBEVAS_GENERIC_LOADERS_SVG
	bool "SVG loader"
	select BR2_PACKAGE_LIBRSVG
	select BR2_PACKAGE_CAIRO
	depends on BR2_ARCH_HAS_ATOMICS # cairo
	help
	  This option enables the Evas generic SVG loader

endif

comment "libevas generic loaders needs udev /dev management and a toolchain w/ C++, dynamic library, threads, wchar"
	depends on !BR2_PACKAGE_HAS_UDEV || !BR2_INSTALL_LIBSTDCPP || BR2_STATIC_LIBS || !BR2_TOOLCHAIN_HAS_THREADS || !BR2_USE_WCHAR
	depends on BR2_USE_MMU
```

## package/llvm/Config.in.host
```kconfig
config BR2_PACKAGE_LLVM_ARCH_SUPPORTS
	bool
	# http://llvm.org/docs/GettingStarted.html#host-c-toolchain-both-compiler-and-standard-library
	# http://llvm.org/docs/GettingStarted.html#local-llvm-configuration
	default y if BR2_HOST_GCC_AT_LEAST_4_7 && \
		(BR2_aarch64 || BR2_arm || BR2_i386 || BR2_x86_64)

config BR2_PACKAGE_HOST_LLVM
	bool "host llvm"
	depends on BR2_PACKAGE_LLVM_ARCH_SUPPORTS
	help
	  The LLVM Project is a collection of modular and reusable compiler
	  and toolchain technologies.

	  http://llvm.org
```

## package/python-efl/Config.in
```kconfig
config BR2_PACKAGE_PYTHON_EFL
	bool "python-efl"
	depends on BR2_PACKAGE_EFL
	select BR2_PACKAGE_ELEMENTARY
	select BR2_PACKAGE_DBUS_PYTHON
	depends on BR2_PACKAGE_PYTHON || BR2_PACKAGE_PYTHON3
	help
	  Python-efl are the python bindings for the whole EFL stack (eo,
	  evas, ecore, edje, emotion, ethumb and elementary)

	  https://www.enlightenment.org/
```

## package/rage/Config.in
```kconfig
config BR2_PACKAGE_RAGE
	bool "rage"
	depends on BR2_PACKAGE_EFL
	help
	  Rage is a Video + Audio player along the lines of mplayer.
	  It's based on ELF libraries.
```

## package/sdl2/Config.in
```kconfig
config BR2_PACKAGE_SDL2
	depends on !BR2_STATIC_LIBS
	bool "sdl2"
	help
	  Simple DirectMedia Layer 2 - SDL2 is a library that allows
	  programs portable low level access to a video framebuffer,
	  audio output, mouse, and keyboard. It is not compatible with SDL1.

	  http://www.libsdl.org/

comment "sdl2 needs a toolchain w/ dynamic library"
        depends on BR2_STATIC_LIBS

if BR2_PACKAGE_SDL2

config BR2_PACKAGE_SDL2_DIRECTFB
	bool "DirectFB video driver"
	depends on BR2_PACKAGE_DIRECTFB

config BR2_PACKAGE_SDL2_X11
	bool "X11 video driver"
	depends on BR2_PACKAGE_XORG7
	select BR2_PACKAGE_XLIB_LIBX11
	select BR2_PACKAGE_XLIB_LIBXEXT

endif
```

## package/skeleton-sysv/Config.in
```kconfig
config BR2_PACKAGE_SKELETON_SYSV
	bool
	select BR2_PACKAGE_HAS_SKELETON

config BR2_PACKAGE_PROVIDES_SKELETON
	default "skeleton-sysv" if BR2_PACKAGE_SKELETON_SYSV
```

## package/skeleton/Config.in
```kconfig
# Every packages depend on the 'skeleton' package, but noone selects its
# symbol since it is an implicit dependency. So we just force that symbol
# to always be 'y' so that it does appear in the dependency graph. Just
# for that, no kidding.
config BR2_PACKAGE_SKELETON
	bool
	default y
	help
	  The basic skeleton for your rootfs.

config BR2_PACKAGE_HAS_SKELETON
	bool

config BR2_PACKAGE_PROVIDES_SKELETON
	string
	depends on BR2_PACKAGE_HAS_SKELETON
```

## package/terminology/Config.in
```kconfig
config BR2_PACKAGE_TERMINOLOGY
	bool "terminology"
	select BR2_PACKAGE_EFL
	select BR2_PACKAGE_LIBELEMENTARY
	depends on BR2_INSTALL_LIBSTDCPP # efl
	depends on BR2_PACKAGE_HAS_UDEV # efl -> libudev
	depends on BR2_USE_MMU # efl
	depends on !BR2_STATIC_LIBS # efl
	depends on BR2_USE_WCHAR # efl
	help
	  Terminology is an EFL terminal emulator with some extra bells
	  and whistles.

comment "terminology needs udev /dev management and a toolchain w/ C++, dynamic library, wchar"
	depends on !BR2_PACKAGE_HAS_UDEV || !BR2_INSTALL_LIBSTDCPP || BR2_STATIC_LIBS || !BR2_USE_WCHAR
	depends on BR2_USE_MMU
```

## package/x11r7/xlib_libXp/Config.in
```kconfig
config BR2_PACKAGE_XLIB_LIBXP
	bool "libXp"
	select BR2_PACKAGE_XLIB_LIBX11
	select BR2_PACKAGE_XLIB_LIBXAU
	select BR2_PACKAGE_XLIB_LIBXEXT
	select BR2_PACKAGE_XPROTO_PRINTPROTO
	select BR2_PACKAGE_XUTIL_UTIL_MACROS
	help
	  X.Org Print Client Library
	  libXp provides public APIs to allow client applications to render
	  to non-display devices.
```

## package/x11r7/xlib_libXpresent/Config.in
```kconfig
config BR2_PACKAGE_XLIB_LIBXPRESENT
	bool "libXpresent"
	select BR2_PACKAGE_XLIB_LIBXEXT
	select BR2_PACKAGE_XPROTO_PRESENTPROTO
	help
	  X.Org libXpresent library
```

## package/x11r7/xproto_printproto/Config.in
```kconfig
config BR2_PACKAGE_XPROTO_PRINTPROTO
	bool "printproto"
	select BR2_PACKAGE_XUTIL_UTIL_MACROS
	help
	  X.Org Print protocol headers
	  The printproto package provides the protocol headers for the
	  xlib_libXp package.
```
